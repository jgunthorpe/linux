## Documentation/devicetree/bindings/gpio/gpio-generic.txt
```
* General purpose MMIO GPIO controller

Required properties:
- compatible: "linux,basic-mmio-gpio" or "linux,basic-mmio-gpio-be",
  the choice determines which bit is considered GPIO #0
- reg and reg-names: An array of named register ranges describing the windows,
  in one of these combinations:
   * 'dat' - Single input/output data register.
   * 'dat', 'set' and 'clr' - 'dat' is the input and drive 1 writes high to 'set'
                              and drive 0 writes high to 'clr'
   * 'dat' and 'set' - 'dat' is the input and drive 1 write high to 'set' and
                       drive 0 writes low to set
  Additionally one of these may be specified:
   * dirout - Write 1 to set as output, 0 to set as input
   * dirin - Write 1 to set as input, 0 to set as output

  The size of the registers should be 1, 4 or 8.
- #gpio-cells: Should be two.
- gpio-controller: Marks the device node as a GPIO controller.

Example:
	gpio0: gpio@8 {
	        #gpio-cells = <2>;
		compatible = "linux,basic-mmio-gpio";
		gpio-controller;
		reg-names = "dat", "set", "dirin";
		reg = <0x8 4>, <0xc 4>, <0x10 4>;
	};
```

## Documentation/devicetree/bindings/interrupt-controller/marvell,kirkwood-host2cpu-intc.txt
```
Marvell Kirkwood SoC Host2CPU doorbell interrupt controller


Required properties:
- compatible: shall be "marvell,kirkwood-host2cpu-intc"
- reg: base address of host2cpu interrupt registers starting with CAUSE register
- interrupts: bridge interrupt of the main interrupt controller
- interrupt-controller: identifies the node as an interrupt controller
- #interrupt-cells: number of cells to encode an interrupt source, shall be 1

Example:
		msi_intc: interrupt-controller@20400 {
			compatible = "marvell,kirkwood-host2cpu-intc";
			#interrupt-cells = <1>;
			interrupt-controller;
			interrupts = <2>;
			reg = <0x20400 0x08>;
		};
```

## Documentation/devicetree/bindings/net/mv643xx.txt
```
mv643xx related nodes.

marvell,mdio-mv643xx:

Required properties:

 - interrupts : <a> where a is the SMI interrupt number.
 - reg : the base address and size of the controllers register space.

Optional properties:
 - shared_smi : on some chips, the second PHY is "shared", meaning it is
	really accessed via the first SMI controller. It is passed in this
	way due to the present structure of the driver, which requires the
	base address for the MAC to be passed in via the SMI controllers
	platform data.
 - tx_csum_limit : on some devices, this option is required for proper
	operation wrt. jumbo frames.


Example:

smi0: mdio@72000 {
	compatible = "marvell,mdio-mv643xx";
	reg = <0x72000 0x4000>;
	interrupts = <46>;
	tx_csum_limit = <1600>;
	status = "disabled";
};

smi1: mdio@76000 {
	compatible = "marvell,mdio-mv643xx";
	reg = <0x76000 0x4000>;
	interrupts = <47>;
	shared_smi = <&smi0>;
	tx_csum_limit = <1600>;
	status = "disabled";
};



marvell,mv643xx-eth:

Required properties:
 - interrupts : the port interrupt number.
 - mdio : phandle of the smi device as drescribed above

Optional properties:
 - port_number : the port number on this bus.
 - phy_addr : the PHY address.
 - reg : should match the mdio reg this device is attached to.
	this is a required hack for now due to the way the
	driver is constructed. This allows the device clock to be
	kept running so that the MAC is not lost after boot.


Example:

egiga0 {
	compatible = "marvell,mv643xx-eth";
	reg = <0x72000 0x4000>;
	mdio = <&smi0>;
	port_number = <0>;
	phy_addr = <0x80>;
	interrupts = <11>;
};

egiga1 {
	compatible = "marvell,mv643xx-eth";
	reg = <0x76000 0x4000>;
	mdio = <&smi1>;
	port_number = <0>;
	phy_addr = <0x81>;
	interrupts = <15>;
};
```

## Documentation/devicetree/bindings/watchdog/marvel.txt
```
* Marvell Orion Watchdog Time

Required Properties:

- Compatibility : "marvell,orion-wdt"
- reg		: Address of the timer registers

Optional properties:

- timeout-sec	: Contains the watchdog timeout in seconds
- interrupts : The interrupt that will trigger when the watchdog expires. If
               this is set then the kernel will call panic when the interrupt
               asserts, which may produce a result depending on how the
               platform's reset logic works.  Use interrupt-parent to specify
               the interrupt controller if the interrupt is not routed to the
               default conteroller.

Example:

	wdt@20300 {
		compatible = "marvell,orion-wdt";
		interrupt-parent = <&bridge_intc>;
		interrupts = <3>;
		reg = <0x20300 0x28>;
		timeout-sec = <10>;
		status = "okay";
	};
```
