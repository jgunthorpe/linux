## drivers/iommu/generic_pt/Kconfig
```kconfig
# SPDX-License-Identifier: GPL-2.0-only

menuconfig GENERIC_PT
	bool "Generic Radix Page Table"
	help
	  Generic library for building radix tree page tables.

	  Generic PT provides a set of HW page table formats and a common
	  set of APIs to work with them.

if GENERIC_PT
config DEBUG_GENERIC_PT
	bool "Extra debugging checks for GENERIC_PT"
	help
	  Enable extra run time debugging checks for GENERIC_PT code. This
	  incurs a runtime cost and should not be enabled for production
	  kernels.

	  The kunit tests require this to be enabled to get full coverage.

config IOMMU_PT
	tristate "IOMMU Page Tables"
	select IOMMU_API
	depends on IOMMU_SUPPORT
	depends on GENERIC_PT
	help
	  Generic library for building IOMMU page tables

	  IOMMU_PT provides an implementation of the page table operations
	  related to struct iommu_domain using GENERIC_PT. It provides a single
	  implementation of the page table operations that can be shared by
	  multiple drivers.

if IOMMU_PT
config IOMMU_PT_AMDV1
	tristate "IOMMU page table for 64-bit AMD IOMMU v1"
	depends on !GENERIC_ATOMIC64 # for cmpxchg64
	help
	  iommu_domain implementation for the AMD v1 page table. AMDv1 is the
	  "host" page table. It supports granular page sizes of almost every
	  power of 2 and decodes an full 64-bit IOVA space.

	  Selected automatically by an IOMMU driver that uses this format.

config IOMMU_PT_ARMV7S
	tristate "IOMMU page table for the 32 bit ARMv7/v8 Short Descriptor Format"
	help
	  iommu_domain implementation for the ARM Short-descriptor pagetable
	  format. This supports 32-bit virtual and physical addresses mapped
	  using 2-level tables with 4KB pages/1MB sections, and contiguous
	  entries for 64KB pages/16MB supersections.

	  Selected automatically by an IOMMU driver that uses this format.

config IOMMU_PT_ARMV8_4K
	tristate "IOMMU page table for 64 bit ARMv8 4k page size"
	depends on !GENERIC_ATOMIC64 # for cmpxchg64
	help
	  iommu_domain implementation for the ARMv8 VMSAv8-64 and the VMSAv8-32
	  long descriptor pagetable format. This format supports both stage-1
	  and stage-2, as well as address spaces up to 48-bits in size. 4K
	  granule size version.

	  Selected automatically by an IOMMU driver that uses this format.

config IOMMU_PT_ARMV8_16K
	tristate "IOMMU page table for 64 bit ARMv8 16k page size"
	depends on !GENERIC_ATOMIC64 # for cmpxchg64
	help
	  iommu_domain implementation for the ARMv8 VMSAv8-64 and the VMSAv8-32
	  long descriptor pagetable format. This format supports both stage-1
	  and stage-2, as well as address spaces up to 48-bits in size. 16K
	  granule size version.

	  Selected automatically by an IOMMU driver that uses this format.

config IOMMU_PT_ARMV8_64K
	tristate "IOMMU page table for 64 bit ARMv8 64k page size"
	depends on !GENERIC_ATOMIC64 # for cmpxchg64
	help
	  iommu_domain implementation for the ARMv8 VMSAv8-64 and the VMSAv8-32
	  long descriptor pagetable format. This format supports both stage-1
	  and stage-2, as well as address spaces up to 48-bits in size. 64K
	  granule size version.

	  Selected automatically by an IOMMU driver that uses this format.

config IOMMU_PT_DART
       tristate "IOMMU page table for Apple Silicon DART"
	depends on !GENERIC_ATOMIC64 # for cmpxchg64
	help
	  iommu_domain implementation for the Apple DART pagetable formats.
	  These include the t8020 and t6000/t8110 DART formats used in Apple
	  M1/M2 family SoCs.

	  Selected automatically by an IOMMU driver that uses this format.

config IOMMU_PT_RISCV64
       tristate "IOMMU page table for RISC-V 64 bit Sv57/Sv48/Sv39"
	depends on !GENERIC_ATOMIC64 # for cmpxchg64
	help
	  iommu_domain implementation for RISC-V 64 bit 3/4/5 level page table.
	  It supports 4K/2M/1G/512G/256T page sizes and can decode a sign
	  extended portion of the 64 bit IOVA space.

	  Selected automatically by an IOMMU driver that uses this format.

config IOMMU_PT_VTDSS
       tristate "IOMMU page table for Intel VT-d Second Stage"
	depends on !GENERIC_ATOMIC64 # for cmpxchg64
	help
	  iommu_domain implementation for the Intel VT-d's 64 bit 3/4/5
	  level Second Stage page table. It is similar to the X86_64 format with
	  4K/2M/1G page sizes.

	  Selected automatically by an IOMMU driver that uses this format.

config IOMMU_PT_X86_64
	tristate "IOMMU page table for x86 64-bit, 4/5 levels"
	depends on !GENERIC_ATOMIC64 # for cmpxchg64
	help
	  iommu_domain implementation for the x86 64-bit 4/5 level page table.
	  It supports 4K/2M/1G page sizes and can decode a sign-extended
	  portion of the 64-bit IOVA space.

	  Selected automatically by an IOMMU driver that uses this format.

config IOMMU_PT_KUNIT_TEST
	tristate "IOMMU Page Table KUnit Test" if !KUNIT_ALL_TESTS
	select IOMMU_IO_PGTABLE
	depends on KUNIT
	depends on IOMMU_PT_AMDV1 || !IOMMU_PT_AMDV1
	depends on IOMMU_PT_ARMV7S || !IOMMU_PT_ARMV7S
	depends on IOMMU_PT_ARMV8_4K || !IOMMU_PT_ARMV8_4K
	depends on IOMMU_PT_ARMV8_16K || !IOMMU_PT_ARMV8_16K
	depends on IOMMU_PT_ARMV8_64K || !IOMMU_PT_ARMV8_64K
	depends on IOMMU_PT_DART || !IOMMU_PT_DART
	depends on IOMMU_PT_RISCV64 || !IOMMU_PT_RISCV64
	depends on IOMMU_PT_VTDSS || !IOMMU_PT_VTDSS
	depends on IOMMU_PT_X86_64 || !IOMMU_PT_X86_64
	default KUNIT_ALL_TESTS
	help
	  Enable kunit tests for GENERIC_PT and IOMMU_PT that covers all the
	  enabled page table formats. The test covers most of the GENERIC_PT
	  functions provided by the page table format, as well as covering the
	  iommu_domain related functions.

config IOMMU_PT_KUNIT_BENCHMARK
	bool "IOMMU Page Table Kunit Tests for comparison benchmarks"
	depends on IOMMU_PT_KUNIT_TEST
	depends on IOMMU_PT_AMDV1
	depends on AMD_IOMMU
endif
endif
```
